/*
  Affichage d'images noir et blanc sur un minitel
  Quimper, 27 juin 2017 / arduino 1.8.2 @ urzhiata
  Révisé le 15 fev 2022 pierre@lesporteslogiques.net
  arduino 1.8.5 @ kirin / Debian 9.5 Stretch

  Minitel library for Arduino (version ?) https://github.com/imclab/Minitel

  Flash Library 1.0.1 by Mikel Hart https://github.com/schinken/Flash
    (pour faciliter les accès à la mémoire PROGMEM)

  Le croquis utilise 11124/30720 octets (36%) de l'espace de stockage de programmes. .
  Les variables globales utilisent 782/2048 octets (38%) de mémoire dynamique.

*/

#include <Flash.h>
#include <SoftwareSerial.h>
#include <Minitel.h>

Minitel m;

// palmier, blanc sur fond noir
FLASH_ARRAY(byte, c, 32,
            32, 32, 32, 32, 32, 32, 32, 32, 32, 32, 32, 32,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 32,
            32, 32, 32, 32, 32, 32, 32, 32, 32, 35, 109, 127,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 32,
            32, 32, 32, 32, 32, 32, 32, 32, 32, 32, 32, 32,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 32,
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            32, 32, 32, 32, 32, 32, 32, 112, 124, 124, 127, 127,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 127
           );

// i love innovation, blanc sur fond noir
FLASH_ARRAY(byte, d, 32,
            32, 32, 32, 32, 32, 32, 32, 32, 32, 32, 32, 32,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 32,
            32, 32, 32, 32, 32, 32, 32, 32, 32, 32, 32, 32,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 32,
            32, 32, 32, 32, 32, 32, 32, 32, 32, 32, 32, 32,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 127,
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            32, 32, 32, 32, 32, 32, 32, 32, 32, 32, 32, 32,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 32, 32);

// pouce "like" blanc sur fond noir
FLASH_ARRAY(byte, f, 32,
            32, 32, 32, 32, 32, 32, 32, 32, 32, 32, 32, 32,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 32,
            32, 32, 32, 32, 32, 32, 32, 32, 32, 32, 32, 32,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 32,
            32, 32, 32, 32, 32, 32, 32, 32, 32, 32, 32, 32,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 56,
            33, 32, 32, 104, 33, 32, 32, 32, 32, 32, 32, 32,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 32,
            32, 32, 32, 32, 32, 32, 32, 32, 32, 106, 32, 32,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 32,
            32, 32, 32, 32, 32, 32, 32, 40, 49, 32, 32, 32,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 32,
            32, 32, 32, 32, 32, 32, 32, 32, 32, 34, 45, 44, 44, 44, 46, 33, 32, 41, 44, 112, 112, 112, 112, 112, 112, 56, 44, 33, 32, 32, 32, 32, 32);

int mode = 0;

void setup() {
}

void loop() {

  if (mode == 0) {
    ecranTitre();
    delay(12000);
  }

  if (mode == 1) {
    m.graphicMode();
    m.clearScreen();
    m.textColor(WHITE);
    m.bgColor(BLACK);
    m.noPixelate();
    for (int i = 0; i < f.count(); i++) {
      m.textByte(f[i]);
    }
    m.textMode();
    m.noCursor();
    m.textColor(WHITE);
    m.bgColor(BLACK);
    m.charSize(SIZE_NORMAL);
    m.textColor(BLACK);
    m.bgColor(WHITE);
    m.blink();
    m.text("                                        ",    1, 21);
    m.text("    https://lesporteslogiques.net       ",    1, 22);
    m.text("      xor@lesporteslogiques.net         ",    1, 23);
    m.text("                                        ",    1, 24);
    m.noBlink();
    delay(8000);
  }

  if (mode == 2) {
    m.graphicMode();
    m.clearScreen();
    m.textColor(BLACK);
    m.bgColor(WHITE);
    m.noPixelate();
    for (int i = 0; i < d.count(); i++) {
      m.textByte(d[i]);
    }
    delay(5000);
  }

  mode ++;
  if (mode > 2) mode = 0;
}

void ecranTitre() {
  m.graphicMode();
  m.clearScreen();
  m.textColor(WHITE);
  m.bgColor(BLACK);
  m.pixelate();
  for (int i = 0; i < c.count(); i++) {
    m.textByte(c[i]);
  }
  m.noPixelate();

  m.textMode();
  m.textColor(WHITE);
  m.bgColor(BLACK);
  m.charSize(SIZE_DOUBLE);
  m.textChar('L', 1, 3);
  m.textChar('E', 3, 3);
  m.textChar('S', 5, 3);
  m.textChar('P', 1, 5);
  m.textChar('O', 3, 5);
  m.textChar('R', 5, 5);
  m.textChar('T', 7, 5);
  m.textChar('E', 9, 5);
  m.textChar('S', 11, 5);
  m.textChar('L', 1, 7);
  m.textChar('O', 3, 7);
  m.textChar('G', 5, 7);
  m.textChar('I', 7, 7);
  m.textChar('Q', 9, 7);
  m.textChar('U', 11, 7);
  m.textChar('E', 13, 7);
  m.textChar('S', 15, 7);

  m.charSize(SIZE_NORMAL);
  m.text("Culture",    4, 11);
  m.text("Numérique",  4, 13);
  m.text("Ludique",    4, 15);
  m.text("Créative",   4, 17);

  m.bgColor(WHITE);
  m.textColor(BLACK);
  m.text("                                        ",    1, 21);
  m.text("    https://lesporteslogiques.net       ",    1, 22);
  m.text("      xor@lesporteslogiques.net         ",    1, 23);
  m.text("                                        ",    1, 24);
}

